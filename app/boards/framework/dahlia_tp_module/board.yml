## app/boards/framework/dahlia_tp_module/board.yml
```yaml
board:
  name: dahlia_tp_module
  full_name: Dahlia Touchpad Module
  vendor: framework
  socs:
    - name: stm32u073xx
```

## app/boards/framework/dahlia_tp_module_evt/Kconfig.dahlia_tp_module_evt
```kconfig
# Copyright (c) 2026
# SPDX-License-Identifier: Apache-2.0

config BOARD_DAHLIA_TP_MODULE_EVT
	select SOC_STM32U073XX
```

## app/boards/framework/dahlia_tp_module_evt/board.yml
```yaml
board:
  name: dahlia_tp_module_evt
  full_name: Dahlia Touchpad Module (EVT)
  vendor: framework
  socs:
    - name: stm32u073xx
```

## app/boards/shields/framework13/Kconfig.defconfig
```kconfig
# Copyright (c) 2022 The ZMK Contributors
# SPDX-License-Identifier: MIT

if SHIELD_FRAMEWORK13

config ZMK_KEYBOARD_NAME
    default "Framework 13"

endif
```

## app/boards/shields/framework13/Kconfig.shield
```kconfig
# Copyright (c) 2022 The ZMK Contributors
# SPDX-License-Identifier: MIT

config SHIELD_FRAMEWORK13_BASE
    bool

config SHIELD_FRAMEOWRK13
    def_bool $(shields_list_contains,framework13)
    select SHIELD_FRAMEWORK13_BASE
```

## app/boards/shields/framework_laptop/Kconfig.defconfig
```kconfig
# Copyright (c) 2022 The ZMK Contributors
# SPDX-License-Identifier: MIT

if SHIELD_FRAMEWORK_LAPTOP

config ZMK_KEYBOARD_NAME
    default "Framework Laptop"

endif
```

## app/boards/shields/framework_laptop/Kconfig.shield
```kconfig
# Copyright (c) 2022 The ZMK Contributors
# SPDX-License-Identifier: MIT

config SHIELD_FRAMEWORK_LAPTOP_BASE
    bool

config SHIELD_FRAMEWORK_LAPTOP
    def_bool $(shields_list_contains,framework_laptop)
    select SHIELD_FRAMEWORK_LAPTOP_BASE
```

## app/module/drivers/Kconfig
```kconfig
# Copyright (c) 2020 The ZMK Contributors
# SPDX-License-Identifier: MIT

rsource "gpio/Kconfig"
rsource "i2c/Kconfig"
rsource "kscan/Kconfig"
rsource "sensor/Kconfig"
rsource "display/Kconfig"
rsource "input/Kconfig"
```

## app/module/drivers/i2c/Kconfig
```kconfig
# Copyright (c) 2026
# SPDX-License-Identifier: Apache-2.0

rsource "target/Kconfig.i2c_hid"
rsource "target/Kconfig.i2c_it8801"
```

## app/module/drivers/i2c/target/Kconfig.i2c_hid
```kconfig
# I2C HID Target configuration options

# Copyright (c) 2026
# SPDX-License-Identifier: Apache-2.0

config I2C_HID_TARGET
	bool "I2C HID Target driver"
	depends on GPIO
	help
	  Enable the I2C HID target device driver. This implements the
	  device/target side of the Microsoft HID over I2C protocol (v1.00),
	  allowing a Zephyr device to appear as an HID peripheral to a host
	  via I2C.
```

## app/module/drivers/i2c/target/Kconfig.i2c_it8801
```kconfig
# I2C IT8801 GPIO expander emulation target

# Copyright (c) 2026
# SPDX-License-Identifier: Apache-2.0

config I2C_IT8801_TARGET
	bool "I2C IT8801 GPIO expander emulation target"
	depends on GPIO
	help
	  Emulates a subset of the ITE IT8801 I/O expander register map
	  as an I2C target device. Allows a host EC with an IT8801 driver
	  to control GPIO pins on this device.
```

## app/module/dts/bindings/i2c/zephyr,i2c-target-hid.yaml
```yaml
# SPDX-License-Identifier: Apache-2.0

description: |
  Zephyr I2C target HID device.
  Implements the device/target side of the Microsoft HID over I2C protocol
  (v1.00), allowing a Zephyr device to appear as an HID peripheral to an
  I2C controller host.

compatible: "zephyr,i2c-target-hid"

include: i2c-device.yaml

properties:
  irq-gpios:
    type: phandle-array
    required: true
    description: |
      GPIO for host interrupt line (active-low). Assertion signals the host
      that input data is available.

  hid-desc-register:
    type: int
    default: 1
    description: |
      Register address from which the host reads the HID descriptor.
      Default is 0x0001 per the HID over I2C specification.

  vid:
    type: int
    required: true
    description: USB Vendor ID reported in the HID descriptor.

  pid:
    type: int
    required: true
    description: USB Product ID reported in the HID descriptor.

  version-id:
    type: int
    default: 256
    description: |
      Device version ID (BCD format) reported in the HID descriptor.
      Default is 0x0100 (version 1.0).

  max-input-length:
    type: int
    required: true
    description: |
      Maximum input report length including the 2-byte length prefix.
      Must be large enough for the longest input report plus 2 bytes.

  max-output-length:
    type: int
    default: 0
    description: |
      Maximum output report length including the 2-byte length prefix.
      Set to 0 if the device does not accept output reports.

  report-desc-length:
    type: int
    required: true
    description: Size in bytes of the HID report descriptor.

  fw-flags:
    type: int
    default: 0
    description: |
      Vendor flags reported in the HID descriptor's 4-byte reserved field
      (offset 26, little endian). Opaque here; bit meanings are the
      board's business. HID-over-I2C v1.0 says the field should be zero
      and no host is known to read it, so it is usable space.

      This is the compile-time value; a board can OR in more at runtime by
      overriding i2c_hid_target_board_fw_flags().
```

## app/module/dts/bindings/i2c/zmk,i2c-target-it8801.yaml
```yaml
# SPDX-License-Identifier: Apache-2.0

description: |
  IT8801 register emulation over I2C target.
  Emulates the subset of the ITE IT8801 register interface that the EC's
  stock IT8801 ioexpander driver needs (vendor ID, SOVR for 3 ports, CR,
  and KSO/KSI stubs). Board code receives a callback on SOVR bit
  transitions and decides what each bit does physically.

compatible: "zmk,i2c-target-it8801"

include: i2c-device.yaml

properties:
  sovr0-init:
    type: int
    default: 0xFF
    description: Initial value of SOVR(0) shadow (host reads this at init).
  sovr1-init:
    type: int
    default: 0xFF
    description: Initial value of SOVR(1) shadow.
  sovr2-init:
    type: int
    default: 0xFF
    description: Initial value of SOVR(2) shadow.
```
