/*
 * Copyright (c) 2025 Framework Computer Inc
 *
 * SPDX-License-Identifier: MIT
 */

#include <dt-bindings/led/led.h>
#include <dt-bindings/zmk/matrix_transform.h>

/ {
    chosen {
	zmk,kscan = &kscan0;
    };
};
