/ {
	kscan0: kscan_matrix {
		compatible = "zmk,kscan-gpio-matrix";
		wakeup-source;

		// col2row means rows are input, cols are output
		diode-direction = "col2row";
		// debounce-press-ms = <1>;
		// debounce-release-ms = <5>;
		// poll-period-ms = <1>;

		// Avoid GPIOs with multiple functions
		// UART on DK: P0.05, P0.06, P0.07, and P0.08
		// NFC on DK: P0.09 and P0.10
		// Buttons and LEDs on DK: P0.11–P0.16 and P0.24–P0.25
		col-gpios
		= <&gpio0  2 (GPIO_ACTIVE_LOW | GPIO_OPEN_DRAIN)> // KSO0
		, <&gpio0  3 (GPIO_ACTIVE_LOW | GPIO_OPEN_DRAIN)> // KSO1
		, <&gpio0  4 (GPIO_ACTIVE_LOW | GPIO_OPEN_DRAIN)> // KSO2
		, <&gpio0  5 (GPIO_ACTIVE_LOW | GPIO_OPEN_DRAIN)> // KSO3 UART
		, <&gpio0  7 (GPIO_ACTIVE_LOW | GPIO_OPEN_DRAIN)> // KSO4 UART
		, <&gpio0  9 (GPIO_ACTIVE_LOW | GPIO_OPEN_DRAIN)> // KSO5 NFC
		, <&gpio0 10 (GPIO_ACTIVE_LOW | GPIO_OPEN_DRAIN)> // KSO6 NFC
		, <&gpio0 11 (GPIO_ACTIVE_LOW | GPIO_OPEN_DRAIN)> // KSO7 Button 1
		, <&gpio0 12 (GPIO_ACTIVE_LOW | GPIO_OPEN_DRAIN)> // KSO8 Button 2
		, <&gpio0 16 (GPIO_ACTIVE_LOW | GPIO_OPEN_DRAIN)> // KSO9 LED 4
		, <&gpio0 17 (GPIO_ACTIVE_LOW | GPIO_OPEN_DRAIN)> // KS10 QSPI CS
		, <&gpio0 19 (GPIO_ACTIVE_LOW | GPIO_OPEN_DRAIN)> // KS11 QSPI SCLK
		, <&gpio0 20 (GPIO_ACTIVE_LOW | GPIO_OPEN_DRAIN)> // KS12 QSPI_DIO0
		, <&gpio0 21 (GPIO_ACTIVE_LOW | GPIO_OPEN_DRAIN)> // KS13 QSPI_DIO1
		, <&gpio0 22 (GPIO_ACTIVE_LOW | GPIO_OPEN_DRAIN)> // KS14 QSPI_DIO2
		, <&gpio0 23 (GPIO_ACTIVE_LOW | GPIO_OPEN_DRAIN)> // KS15 QSPI_DIO3
		, <&gpio0 24 (GPIO_ACTIVE_LOW | GPIO_OPEN_DRAIN)> // KS16 Button 3
		, <&gpio0 25 (GPIO_ACTIVE_LOW | GPIO_OPEN_DRAIN)> // KS17 Button 4
		;

		row-gpios
		= <&gpio1  0 (GPIO_ACTIVE_LOW | GPIO_PULL_UP)> // KSI0 TRACEDATA[0]
		, <&gpio1  3 (GPIO_ACTIVE_LOW | GPIO_PULL_UP)> // KSI1
		, <&gpio1  4 (GPIO_ACTIVE_LOW | GPIO_PULL_UP)> // KSI2
		, <&gpio1  5 (GPIO_ACTIVE_LOW | GPIO_PULL_UP)> // KSI3
		, <&gpio1  6 (GPIO_ACTIVE_LOW | GPIO_PULL_UP)> // KSI4
		, <&gpio1  7 (GPIO_ACTIVE_LOW | GPIO_PULL_UP)> // KSI5
		, <&gpio1  8 (GPIO_ACTIVE_LOW | GPIO_PULL_UP)> // KSI6
		, <&gpio1  9 (GPIO_ACTIVE_LOW | GPIO_PULL_UP)> // KSI7 TRACEDATA[3]
		;
	};
};

// Disable UART on the devkit to use those pins as GPIO
// GPIO P0.05 and P0.07
&uart0 {
	status = "disabled";
};

&uicr {
	// Use 	P0.09 and P0.10 as GPIO for KSO instead of NFC
	nfct-pins-as-gpios;
};
