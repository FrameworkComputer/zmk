/ {
    leds {
        compatible = "gpio-leds";
        /* Capslock LED on keyboard membrane. Has pulldown on main PCB */
        caps_led: led_3 {
            gpios = <&gpioc          15 GPIO_ACTIVE_HIGH>;
        };
    };
};
